## Kconfig
```kconfig
config SG_FS
	tristate "Sgfs stackable file system (EXPERIMENTAL)"
	help
	  Sgfs is a stackable file system which simply passes its
	  operations to the lower layer.  It is designed as a useful
	  template for developing or debugging other stackable file systems,
	  and more (see Documentation/filesystems/sgfs.txt).
```
